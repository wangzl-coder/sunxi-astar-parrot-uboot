## configs/A33-astar-parrot_defconfig
```kconfig
CONFIG_ARM=y
CONFIG_ARCH_SUNXI=y
CONFIG_SPL=y
CONFIG_MACH_SUN8I_A33=y
CONFIG_DRAM_CLK=522
CONFIG_DRAM_ZQ=15291
CONFIG_DRAM_ODT_EN=y
CONFIG_MMC0_CD_PIN="PB4"
CONFIG_USB0_VBUS_PIN="AXP0-VBUS-ENABLE"
CONFIG_USB0_VBUS_DET="AXP0-VBUS-DETECT"
CONFIG_USB0_ID_DET="PB3"
CONFIG_AXP_GPIO=y
CONFIG_VIDEO_LCD_MODE="x:1024,y:600,depth:18,pclk_khz:50000,le:10,ri:300,up:10,lo:15,hs:10,vs:10,sync:3,vmode:0"
CONFIG_VIDEO_LCD_DCLK_PHASE=0
CONFIG_VIDEO_LCD_BL_EN="PL11"
CONFIG_VIDEO_LCD_BL_PWM="PH0"
CONFIG_NR_DRAM_BANKS=1
# CONFIG_SYS_MALLOC_CLEAR_ON_INIT is not set
# CONFIG_CMD_FLASH is not set
# CONFIG_SPL_DOS_PARTITION is not set
# CONFIG_SPL_EFI_PARTITION is not set
CONFIG_DEFAULT_DEVICE_TREE="sun8i-a33-astar-parrot"
CONFIG_AXP_DCDC1_VOLT=3300
CONFIG_USB_MUSB_HOST=y
CONFIG_USB_EHCI_HCD=y
CONFIG_USB_OHCI_HCD=y
CONFIG_USB_EHCI_GENERIC=y
CONFIG_USB_OHCI_GENERIC=y
CONFIG_SYS_USB_EVENT_POLL_VIA_INT_QUEUE=y
CONFIG_SYS_BOARD="sun8iw5p1_astar_parrot"
CONFIG_SYS_CONFIG_NAMR="sun8iw5p1_astar_parrot"
CONFIG_CONS_INDEX=4
CONFIG_PINCTRL=y
CONFIG_PINCTRL_SUNXI=y
CONFIG_PINCTRL_SUN8I_A33=y
CONFIG_USB_HOST_ETHER=y
CONFIG_USB_ETHER_RTL8152=y
```

## configs/sun8iw5p1_a33_astar_parrot_defconfig
```kconfig
CONFIG_ARM=y
CONFIG_ARCH_SUNXI=y
#CONFIG_SPL=y
CONFIG_MACH_SUN8I_A33=y
CONFIG_DRAM_CLK=552
CONFIG_DRAM_ZQ=63351
CONFIG_USB0_VBUS_PIN="axp_drivebus"
CONFIG_USB0_VBUS_DET="axp_vbus_detect"
CONFIG_USB1_VBUS_PIN="PH7"
CONFIG_SYS_BOARD="sun8iw5p1_astar_parrot"
CONFIG_SYS_CONFIG_NAME="sun8iw5p1_a33_astar_parrot"
CONFIG_NR_DRAM_BANKS=1
# CONFIG_SYS_MALLOC_CLEAR_ON_INIT is not set
# CONFIG_CMD_FLASH is not set
# CONFIG_SPL_DOS_PARTITION is not set
# CONFIG_SPL_EFI_PARTITION is not set
CONFIG_DEFAULT_DEVICE_TREE="sun8iw5p1-a33-astar-parrot"
CONFIG_CONS_INDEX=5
CONFIG_USB_OHCI_HCD=y
CONFIG_USB_EHCI_HCD=y
CONFIG_SYS_USB_EVENT_POLL_VIA_INT_QUEUE=y
```

## drivers/pinctrl/sunxi/Kconfig
```kconfig
config PINCTRL_SUNXI
    bool

config PINCTRL_SUN8I_A33
    bool "sun8i_a33 pinctrl driver"
    depends on MACH_SUN8I_A33 && PINCTRL
    select PINCTRL_SUNXI
    help
     Say Y here to enable the sun8i_a33 pinctrl driver.
```
